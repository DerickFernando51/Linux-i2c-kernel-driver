/dts-v1/;
/plugin/;

/ {
    compatible = "brcm,bcm2835";       

    fragment@0 {
        target = <&i2c1>;              

        __overlay__ {
            #address-cells = <1>;
            #size-cells = <0>;
            status = "okay";

            mlx90614: mlx90614@5a {
                compatible = "melexis,mlx90614";   
                reg = <0x5A>;                     
                status = "okay";
            };
        };
    };
};
